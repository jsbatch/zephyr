## CMakeLists.txt
```
# SPDX-FileCopyrightText: Copyright (c) 2026 Infineon Technologies AG,
# or an affiliate of Infineon Technologies AG. All rights reserved.
#
# SPDX-License-Identifier: Apache-2.0

cmake_minimum_required(VERSION 3.20.0)

find_package(Zephyr REQUIRED HINTS $ENV{ZEPHYR_BASE})
project(psc3m5_clock_management)

target_sources(app PRIVATE src/main.c)
```

## sample.yaml
```
sample:
  name: PSC3M5 Clock Management Full-Shape
  description: >
    Full-shape PSC3M5 clock tree modelled at SoC scope with the Infineon CAT1
    clock-management producers, plus a consumer that reports every clk_hf root,
    the clock-management / driver ownership boundary for the console UART, and
    the declared-versus-computed rate for an applied state.
tests:
  sample.boards.infineon.psc3m5_clock_management.static:
    platform_allow:
      - kit_psc3m5_evk
    tags:
      - clock_management
      - infineon
    harness: console
    harness_config:
      type: multi_line
      ordered: true
      regex:
        - "PSC3M5 full-shape clock-management demo"
        - "CPU clock declared in devicetree: 180000000 Hz"
        - "High-frequency clock roots"
        - "clk_hf0.*180000000 Hz"
        - "clk_hf1.*180000000 Hz"
        - "clk_hf2.*80000000 Hz"
        - "clk_hf3.*240000000 Hz"
        - "clk_hf4.*96000000 Hz"
        - "Ownership boundary for the console UART"
        - "leaf divider /86"
        - "declared rate .apply_state.*80000000 Hz"
        - "computed rate .get_rate.*80000000 Hz"
        - "declared == computed"
        - "clock-management demo complete"
  sample.boards.infineon.psc3m5_clock_management.runtime:
    platform_allow:
      - kit_psc3m5_evk
    extra_args: EXTRA_CONF_FILE=runtime.conf
    tags:
      - clock_management
      - infineon
    harness: console
    harness_config:
      type: multi_line
      ordered: true
      regex:
        - "PSC3M5 full-shape clock-management demo"
        - "High-frequency clock roots"
        - "clk_hf2.*80000000 Hz"
        - "declared == computed"
        - "Runtime rate request for clk_hf2"
        - "granted rate.*80000000 Hz"
        - "clock-management demo complete"
```

## prj.conf
```kconfig
# SPDX-FileCopyrightText: Copyright (c) 2026 Infineon Technologies AG,
# or an affiliate of Infineon Technologies AG. All rights reserved.
#
# SPDX-License-Identifier: Apache-2.0

# Static-only clock management: CONFIG_CLOCK_MANAGEMENT_RUNTIME is left off so
# states are applied directly by clock_configure() with no runtime tracking.
CONFIG_CLOCK_MANAGEMENT=y
```

## regdirect.conf
```kconfig
# SPDX-FileCopyrightText: Copyright (c) 2026 Infineon Technologies AG,
# or an affiliate of Infineon Technologies AG. All rights reserved.
#
# SPDX-License-Identifier: Apache-2.0

# Overlay fragment: select the register-direct producer backend (Track B).
# Same devicetree model and sample; only the producer implementation changes.
#   west build -b kit_psc3m5_evk samples/boards/infineon/psc3m5_clock_management \
#       -- -DEXTRA_CONF_FILE=regdirect.conf
CONFIG_CLOCK_MANAGEMENT_INFINEON_CAT1_BACKEND_REG=y
```

## runtime.conf
```kconfig
# SPDX-FileCopyrightText: Copyright (c) 2026 Infineon Technologies AG,
# or an affiliate of Infineon Technologies AG. All rights reserved.
#
# SPDX-License-Identifier: Apache-2.0

# Overlay fragment: enable runtime clock management to measure the footprint
# delta and exercise the runtime callbacks.
#   west build -b kit_psc3m5_evk samples/boards/infineon/psc3m5_clock_management \
#       -- -DEXTRA_CONF_FILE=runtime.conf
CONFIG_CLOCK_MANAGEMENT_RUNTIME=y
```

## boards/kit_psc3m5_evk.overlay
```dts
/*
 * SPDX-FileCopyrightText: Copyright (c) 2026 Infineon Technologies AG,
 * or an affiliate of Infineon Technologies AG. All rights reserved.
 *
 * SPDX-License-Identifier: Apache-2.0
 */

/*
 * PSC3M5 clock-management full-shape consumer overlay.
 *
 * The full clock tree is modelled at SoC scope in system_clocks_cm.dtsi, which
 * the board includes. This overlay only adds a demonstration consumer; it
 * defines no producers of its own.
 *
 * The consumer takes an output for every clk_hf root that has one, so the
 * sample can report the whole high-frequency tree through the clock-management
 * API. Each output is paired with the state the SoC already uses for it: the
 * CPU state for clk_hf0, the console state for clk_hf2, and the legacy
 * bring-up states for the roots that still feed unconverted drivers.
 */

/ {
	cm_demo: cm-demo {
		compatible = "vnd,clock-consumer";
		clock-outputs = <&clk_hf0_output>, <&clk_hf1_output>,
				<&clk_hf2_output>, <&clk_hf3_output>,
				<&clk_hf4_output>;
		clock-output-names = "cpu", "hf1", "periclk", "hf3", "hf4";
		clock-state-0 = <&clk_hf0_default>, <&clk_hf1_bringup>,
				<&clk_hf2_default>, <&clk_hf3_bringup>,
				<&clk_hf4_bringup>;
		clock-state-names = "default";
		status = "okay";
	};
};
```

## dts/bindings/vnd,clock-consumer.yaml
```yaml
# SPDX-FileCopyrightText: Copyright (c) 2026 Infineon Technologies AG,
# or an affiliate of Infineon Technologies AG. All rights reserved.
#
# SPDX-License-Identifier: Apache-2.0

description: |
  Prototype clock-management consumer. Carries the clock-outputs and
  clock-state-N properties used by the sample to apply and query states
  through the clock-management API.

compatible: "vnd,clock-consumer"

include: [base.yaml, clock-device.yaml]
```

## src/main.c
```c
/*
 * SPDX-FileCopyrightText: Copyright (c) 2026 Infineon Technologies AG,
 * or an affiliate of Infineon Technologies AG. All rights reserved.
 *
 * SPDX-License-Identifier: Apache-2.0
 */

/**
 * @file
 * @brief PSC3M5 full-shape clock-management consumer demonstration.
 *
 * Reports the PSC3M5 high-frequency clock tree through the clock-management
 * API. The tree itself is modelled at SoC scope in system_clocks_cm.dtsi; this
 * consumer holds only opaque clock-output handles and reads rates through the
 * framework, so it never includes a vendor clock header or touches a register.
 * That is the point of the demonstration: everything printed below is obtained
 * without any Infineon-specific clock code in the application.
 */

#include <zephyr/kernel.h>
#include <zephyr/device.h>
#include <zephyr/devicetree.h>
#include <zephyr/drivers/clock_management.h>
#include <zephyr/sys/printk.h>

#define CONSUMER_NODE DT_NODELABEL(cm_demo)
#define CPU_NODE      DT_NODELABEL(cpu0)
#define CONSOLE_DIV   DT_NODELABEL(peri0_group4_8bit_0)

CLOCK_MANAGEMENT_DT_DEFINE_OUTPUT_BY_NAME(CONSUMER_NODE, cpu);
CLOCK_MANAGEMENT_DT_DEFINE_OUTPUT_BY_NAME(CONSUMER_NODE, hf1);
CLOCK_MANAGEMENT_DT_DEFINE_OUTPUT_BY_NAME(CONSUMER_NODE, periclk);
CLOCK_MANAGEMENT_DT_DEFINE_OUTPUT_BY_NAME(CONSUMER_NODE, hf3);
CLOCK_MANAGEMENT_DT_DEFINE_OUTPUT_BY_NAME(CONSUMER_NODE, hf4);

/* One row of the clk_hf report. */
struct clk_hf_report {
	const char *name;
	const char *users;
	const struct clock_output *out;
};

/*
 * Consumers per root follow the PSC3 clock architecture (Architecture RM
 * Ch.19, Table 112): clk_hf0 is the system clock, and the remaining roots feed
 * the fixed peripheral clock groups.
 */
static const struct clk_hf_report clk_hf_reports[] = {
	{
		.name = "clk_hf0",
		.users = "CPU, PERI, SRSS, groups 0/2",
		.out = CLOCK_MANAGEMENT_DT_GET_OUTPUT_BY_NAME(CONSUMER_NODE, cpu),
	},
	{
		.name = "clk_hf1",
		.users = "LPCOMP, groups 1/3",
		.out = CLOCK_MANAGEMENT_DT_GET_OUTPUT_BY_NAME(CONSUMER_NODE, hf1),
	},
	{
		.name = "clk_hf2",
		.users = "group 4: console UART, CAN",
		.out = CLOCK_MANAGEMENT_DT_GET_OUTPUT_BY_NAME(CONSUMER_NODE, periclk),
	},
	{
		.name = "clk_hf3",
		.users = "HPPASS, group 5: TCPWM, CSG",
		.out = CLOCK_MANAGEMENT_DT_GET_OUTPUT_BY_NAME(CONSUMER_NODE, hf3),
	},
	{
		.name = "clk_hf4",
		.users = "group 6: SCB5 SPI",
		.out = CLOCK_MANAGEMENT_DT_GET_OUTPUT_BY_NAME(CONSUMER_NODE, hf4),
	},
};

static const clock_management_state_t periclk_default =
	CLOCK_MANAGEMENT_DT_GET_STATE(CONSUMER_NODE, periclk, default);

/* The console source clock, reported on its own as well as in the table. */
static const struct clock_output *const console_clk =
	CLOCK_MANAGEMENT_DT_GET_OUTPUT_BY_NAME(CONSUMER_NODE, periclk);

/* Report every clk_hf root the framework exposes an output for. */
static void report_clock_tree(void)
{
	printk("\nHigh-frequency clock roots (read through clock management)\n");

	for (size_t i = 0; i < ARRAY_SIZE(clk_hf_reports); i++) {
		const struct clk_hf_report *row = &clk_hf_reports[i];
		int rate = clock_management_get_rate(row->out);

		if (rate < 0) {
			printk("  %-8s  <get_rate failed: %d>  %s\n", row->name, rate,
			       row->users);
			continue;
		}

		printk("  %-8s  %9d Hz  %s\n", row->name, rate, row->users);
	}
}

/*
 * Show the ownership boundary this port is built around: clock management owns
 * the shared source clock, while the peripheral driver owns the leaf divider
 * that turns it into a bit rate. The divider value is read from devicetree
 * because it belongs to the driver, not to the clock-management tree.
 */
static void report_ownership_boundary(void)
{
	uint32_t div = DT_PROP(CONSOLE_DIV, clock_div);
	int src_rate = clock_management_get_rate(console_clk);

	printk("\nOwnership boundary for the console UART\n");

	if (src_rate < 0) {
		printk("  source rate unavailable (%d)\n", src_rate);
		return;
	}

	if (div == 0U) {
		printk("  leaf divider is zero, cannot derive the bit-rate clock\n");
		return;
	}

	printk("  clk_hf2 source rate (clock management)  %9d Hz\n", src_rate);
	printk("  leaf divider /%u (UART driver)          %9d Hz\n", div,
	       src_rate / (int)div);
	printk("  configured baud rate                    %9d\n",
	       DT_PROP(DT_NODELABEL(uart3), current_speed));
}

/*
 * Compare the rate a state declares with the rate the producers compute. In
 * static mode apply_state() returns the clock-frequency written in devicetree,
 * while get_rate() walks the tree and recomputes it, so a mismatch means the
 * declared value does not match the divider math.
 */
static int report_state_application(void)
{
	int declared;
	int computed;

	printk("\nApplying the clk_hf2 default state\n");

	declared = clock_management_apply_state(console_clk, periclk_default);
	if (declared < 0) {
		printk("  apply_state failed (%d)\n", declared);
		return declared;
	}

	computed = clock_management_get_rate(console_clk);
	if (computed < 0) {
		printk("  get_rate failed (%d)\n", computed);
		return computed;
	}

	printk("  declared rate (apply_state)  %9d Hz\n", declared);
	printk("  computed rate (get_rate)     %9d Hz\n", computed);
	printk("  declared %s computed\n", (declared == computed) ? "==" : "!=");

	return 0;
}

#if defined(CONFIG_CLOCK_MANAGEMENT_RUNTIME)
/*
 * Runtime mode adds frequency negotiation: instead of naming a state, a
 * consumer asks for a range and the producers pick a configuration that fits.
 * The request below brackets the console rate, so it should resolve without
 * changing the clock.
 */
static void report_rate_request(void)
{
	const struct clock_management_rate_req req = {
		.min_freq = 70000000,
		.max_freq = 90000000,
		.max_rank = CLOCK_MANAGEMENT_ANY_RANK,
	};
	int rate = clock_management_req_rate(console_clk, &req);

	printk("\nRuntime rate request for clk_hf2 (70-90 MHz)\n");

	if (rate < 0) {
		printk("  req_rate failed (%d)\n", rate);
		return;
	}

	printk("  granted rate  %9d Hz\n", rate);
}
#endif /* CONFIG_CLOCK_MANAGEMENT_RUNTIME */

int main(void)
{
	int ret;

	printk("PSC3M5 full-shape clock-management demo\n");
	printk("CPU clock declared in devicetree: %d Hz\n",
	       DT_PROP(CPU_NODE, clock_frequency));
	printk("Kernel timer frequency: %u Hz\n", sys_clock_hw_cycles_per_sec());

	report_clock_tree();
	report_ownership_boundary();

	ret = report_state_application();
	if (ret < 0) {
		return 0;
	}

#if defined(CONFIG_CLOCK_MANAGEMENT_RUNTIME)
	report_rate_request();
#endif

	printk("\nclock-management demo complete\n");

	return 0;
}
```
