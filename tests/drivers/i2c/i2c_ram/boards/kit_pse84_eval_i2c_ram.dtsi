/*
 * SPDX-FileCopyrightText: Copyright (c) 2026 Infineon Technologies AG,
 * SPDX-FileCopyrightText: or an affiliate of Infineon Technologies AG.
 *
 * SPDX-License-Identifier: Apache-2.0
 */

/*
 * Shared I2C RAM (FRAM) test devicetree for the PSOC Edge E84 evaluation kit.
 * The m33, m33/ns and m55 board targets all include the same board devicetree
 * (kit_pse84_eval_common.dtsi), so they use this one overlay body instead of
 * keeping a separate identical copy per target.
 */

/ {
	aliases {
		i2c-ram = &arduino_i2c;
	};
};
