## drivers/clock_management/infineon/Kconfig
```kconfig
# SPDX-FileCopyrightText: Copyright (c) 2026 Infineon Technologies AG,
# or an affiliate of Infineon Technologies AG. All rights reserved.
#
# SPDX-License-Identifier: Apache-2.0

config CLOCK_MANAGEMENT_INFINEON_CAT1
	bool
	help
	  Infineon CAT1 clock-management producer drivers.

choice CLOCK_MANAGEMENT_INFINEON_CAT1_BACKEND
	prompt "Infineon CAT1 clock producer backend"
	default CLOCK_MANAGEMENT_INFINEON_CAT1_BACKEND_PDL
	depends on CLOCK_MANAGEMENT_INFINEON_CAT1
	help
	  Selects how the Infineon CAT1 clock-management producers program the
	  hardware. Both backends implement the same devicetree compatibles, so
	  the clock model is unchanged; only the producer implementation differs.

config CLOCK_MANAGEMENT_INFINEON_CAT1_BACKEND_PDL
	bool "PDL runtime"
	help
	  Producers call the PDL (Cy_SysClk_*) runtime functions. No register
	  addresses are required in devicetree.

config CLOCK_MANAGEMENT_INFINEON_CAT1_BACKEND_REG
	bool "Register-direct"
	help
	  Producers write registers directly using the register addresses and
	  bitfield positions provided in devicetree. Family-agnostic; uses no
	  PDL runtime and no vendor register-definition headers.

endchoice

config CLOCK_MANAGEMENT_INFINEON_CAT1_CLOCK_SOURCE
	bool "Infineon CAT1 clock source producer"
	default y
	depends on DT_HAS_INFINEON_CAT1_CLOCK_SOURCE_ENABLED
	select CLOCK_MANAGEMENT_INFINEON_CAT1
	help
	  Root clock-source producer for on-chip oscillators such as the IHO.

config CLOCK_MANAGEMENT_INFINEON_CAT1_PATH_MUX
	bool "Infineon CAT1 clock-path mux producer"
	default y
	depends on DT_HAS_INFINEON_CAT1_PATH_MUX_ENABLED
	select CLOCK_MANAGEMENT_INFINEON_CAT1
	help
	  Clock-path multiplexer producer that selects the reference feeding a
	  FLL/DPLL clock path.

config CLOCK_MANAGEMENT_INFINEON_CAT1_CLK_HF
	bool "Infineon CAT1 clk_hf producer"
	default y
	depends on DT_HAS_INFINEON_CAT1_CLK_HF_ENABLED
	select CLOCK_MANAGEMENT_INFINEON_CAT1
	help
	  High-frequency root clock (clk_hf) producer with source select and
	  integer divider.

config CLOCK_MANAGEMENT_INFINEON_CAT1_PERI_DIV
	bool "Infineon CAT1 peripheral divider producer"
	default y
	depends on DT_HAS_INFINEON_CAT1_PERI_DIV_ENABLED
	select CLOCK_MANAGEMENT_INFINEON_CAT1
	help
	  Peripheral clock divider producer for integer and fractional dividers.

config CLOCK_MANAGEMENT_INFINEON_CAT1_DPLL
	bool "Infineon CAT1 DPLL producer"
	default y
	depends on DT_HAS_INFINEON_CAT1_DPLL_ENABLED
	select CLOCK_MANAGEMENT_INFINEON_CAT1
	help
	  Low-power DPLL producer. The DPLL programming sequence is retained
	  through the vendor library, so this producer is compiled for both the
	  PDL and register-direct backends.

config CLOCK_MANAGEMENT_INFINEON_CAT1_LEGACY_BRINGUP
	bool "Bring up unconverted peripheral clk_hf roots at boot"
	depends on CLOCK_MANAGEMENT_INFINEON_CAT1_CLK_HF
	help
	  Transitional support for incremental clock-management migration. Clock
	  management programs a clk_hf only when a consumer applies its state, so
	  a peripheral driver still on the legacy clock path would find its source
	  clock at reset. When set, the SoC applies a boot-time bring-up state for
	  the peripheral-group clk_hf roots that have no clock-management consumer
	  yet. Enable it on a board that has such drivers; remove it once every
	  clk_hf has a real consumer.
```

## drivers/i2c/target/Kconfig.fault
```kconfig
# I2C fault-injection target configuration options

# SPDX-FileCopyrightText: Copyright The Zephyr Project Contributors
# SPDX-License-Identifier: Apache-2.0

menuconfig I2C_TARGET_FAULT
	bool "I2C fault-injection target driver"
	default y
	depends on DT_HAS_ZEPHYR_I2C_TARGET_FAULT_ENABLED
	help
	  Enable a programmable I2C target that can be told to NACK the
	  address phase, NACK a chosen data byte, refuse to supply a read
	  byte, or hold SCL for a chosen span. It is registered on one
	  controller while a second controller wired to the same SDA and SCL
	  acts as the device under test, so the faults it produces are bus
	  events rather than a simulation of them.

	  The target is a test-support driver and does not model any real
	  device. It is used by tests/drivers/i2c/i2c_fault_injection.

	  The target never delays. Its callbacks run in interrupt context on
	  most controllers, so producing a clock stretch by refusing to return
	  from one is not permissible; a test that wants a stretch installs a
	  hook and pulls SCL low from it instead.

if I2C_TARGET_FAULT

config I2C_TARGET_FAULT_TRACE_DEPTH
	int "Callbacks recorded per target instance"
	default 64
	range 8 1024
	help
	  Number of target callback invocations the driver records. A test
	  reads the trace back to confirm the fault was injected where it
	  intended, rather than inferring it from the value the controller
	  returned. The trace saturates rather than wrapping, because the
	  events of interest are the first ones after a fault is armed.

endif # I2C_TARGET_FAULT
```

## drivers/serial/Kconfig.infineon
```kconfig
# Infineon CAT1 UART configuration options

# Copyright (c) 2022 Cypress Semiconductor Corporation (an Infineon company) or
# an affiliate of Cypress Semiconductor Corporation
# SPDX-License-Identifier: Apache-2.0

config UART_INFINEON_CAT1_HAL
	bool "Infineon CAT1 UART driver"
	default y
	depends on DT_HAS_INFINEON_UART_ENABLED
	depends on USE_INFINEON_LEGACY_HAL
	select SERIAL_HAS_DRIVER
	select SERIAL_SUPPORT_INTERRUPT
	select SERIAL_SUPPORT_ASYNC if !(SOC_FAMILY_INFINEON_CAT1C || SOC_CY8C6244LQI_S4D92)
	select USE_INFINEON_UART
	select PINCTRL
	select DMA if UART_ASYNC_API
	help
	  This option enables the Legacy HAL based UART driver for Infineon CAT1 family.

config UART_INFINEON_CAT1_PDL
	bool "Infineon CAT1 UART driver (PDL)"
	default y
	depends on DT_HAS_INFINEON_UART_ENABLED
	depends on !USE_INFINEON_LEGACY_HAL
	select SERIAL_HAS_DRIVER
	select SERIAL_SUPPORT_INTERRUPT
	select SERIAL_SUPPORT_ASYNC if !SOC_FAMILY_INFINEON_CAT1C
	select USE_INFINEON_UART
	select PINCTRL
	select DMA if UART_ASYNC_API
	select USE_INFINEON_DMA if UART_ASYNC_API
	help
	  This option enables the PDL based UART driver for Infineon CAT1 family.

config UART_INFINEON_CLOCK_MANAGEMENT
	bool "Source the UART clock through the clock-management framework"
	depends on UART_INFINEON_CAT1_PDL
	depends on CLOCK_MANAGEMENT
	help
	  When enabled, the PDL UART driver applies its source clock state and
	  reads its source clock rate through the clock-management framework
	  instead of querying the clk_hf frequency directly. The driver keeps
	  ownership of its own peripheral (baud) divider. The consumer node must
	  provide clock-outputs, clock-output-names, clock-state-0, and
	  clock-state-names properties.
```

## dts/bindings/clock-management/infineon/infineon,cat1-clk-hf.yaml
```yaml
# SPDX-FileCopyrightText: Copyright (c) 2026 Infineon Technologies AG,
# or an affiliate of Infineon Technologies AG. All rights reserved.
#
# SPDX-License-Identifier: Apache-2.0

description: |
  Infineon CAT1 high-frequency root clock (clk_hf) for the clock-management
  framework.

  Models a clk_hf instance as an RFC "standard" clock: it selects a clock path
  as its source and applies an integer divider. The single specifier cell is
  the divider selector (IFX_CLK_HF_* : the divide factor is the enum value
  plus one).

  The clk_hf legal maximum (for example 180 MHz on PSC3) is enforced in driver
  code because it cannot be expressed in the generic clock-node or clock-state
  bindings.

compatible: "infineon,cat1-clk-hf"

include: [clock-node.yaml]

properties:
  input:
    type: phandle
    required: true
    description: Upstream clock (path mux) feeding this clk_hf instance.

  instance:
    type: int
    required: true
    description: clk_hf index programmed by this node.

  source-path:
    type: int
    required: true
    description: |
      Clock path selected as the clk_hf source
      (IFX_CLK_HF_IN_CLKPATH* from dt-bindings/clock/ifx_clock_source_common.h).

  clock-div:
    type: int
    default: 0
    description: |
      Default divider selector (IFX_CLK_HF_* ; divide factor = value + 1).
      Used until a clock-state applies a new value through the specifier cell.

  max-frequency:
    type: int
    description: |
      Optional legal maximum output frequency in Hz. When set, the driver
      rejects a configuration whose output would exceed it.

  # Register-direct backend only (ignored by the PDL backend):
  reg-addr:
    type: int
    description: Absolute address of the CLK_ROOT_SELECT register for this clk_hf.

  mux-lsb:
    type: int
    description: Least-significant bit of the source-select (ROOT_MUX) field.

  mux-width:
    type: int
    description: Width in bits of the source-select field.

  div-lsb:
    type: int
    description: |
      Least-significant bit of the integer-divider field. Set to the
      ROOT_DIV_INT position on SRSS layouts that provide it, or the ROOT_DIV
      position on layouts that do not; this is why the position is a property.

  div-width:
    type: int
    description: Width in bits of the integer-divider field.

  enable-bit:
    type: int
    description: Bit position of the clock-root enable.

  "#clock-cells":
    const: 1

clock-cells:
  - divider
```

## dts/bindings/clock-management/infineon/infineon,cat1-clock-legacy-bringup.yaml
```yaml
# SPDX-FileCopyrightText: Copyright (c) 2026 Infineon Technologies AG,
# or an affiliate of Infineon Technologies AG. All rights reserved.
#
# SPDX-License-Identifier: Apache-2.0

description: |
  Transitional clock-management consumer that brings up the peripheral-group
  clk_hf roots at boot for peripheral drivers not yet converted to clock
  management. Clock management programs a clk_hf only when a consumer applies
  its state, so an unconverted driver would otherwise find its source clock at
  reset. The SoC applies these states when
  CONFIG_CLOCK_MANAGEMENT_INFINEON_CAT1_LEGACY_BRINGUP is set. The node and its
  states are removed once every clk_hf has a real consumer.

compatible: "infineon,cat1-clock-legacy-bringup"

include: [base.yaml, clock-device.yaml]
```

## dts/bindings/clock-management/infineon/infineon,cat1-clock-source.yaml
```yaml
# SPDX-FileCopyrightText: Copyright (c) 2026 Infineon Technologies AG,
# or an affiliate of Infineon Technologies AG. All rights reserved.
#
# SPDX-License-Identifier: Apache-2.0

description: |
  Infineon CAT1 root clock source for the clock-management framework.

  Models a fixed-rate on-chip oscillator (for example the IHO) as an RFC
  "root" clock. The node reports its rate through clock-frequency and gates
  the oscillator through the framework on/off path. It takes no specifier
  cells, so it never appears inside a clock-state "clocks" array.

compatible: "infineon,cat1-clock-source"

include: [clock-node.yaml]

properties:
  clock-frequency:
    type: int
    required: true
    description: Frequency this source provides, in Hz.

  system-clock:
    type: int
    required: true
    description: |
      Infineon clock-block identifier (IFX_* from
      dt-bindings/clock/ifx_clock_source_common.h) selecting which oscillator
      this source drives.

  # Register-direct backend only (ignored by the PDL backend):
  reg-addr:
    type: int
    description: Absolute address of the oscillator configuration/enable register.

  enable-bit:
    type: int
    description: Bit position of the oscillator enable within reg-addr.

  "#clock-cells":
    const: 0
```

## dts/bindings/clock-management/infineon/infineon,cat1-dpll.yaml
```yaml
# SPDX-FileCopyrightText: Copyright (c) 2026 Infineon Technologies AG,
# or an affiliate of Infineon Technologies AG. All rights reserved.
#
# SPDX-License-Identifier: Apache-2.0

description: |
  Infineon CAT1 low-power DPLL (DPLL_LP) for the clock-management framework.

  Modelled as an RFC "standard" clock: its input is the clock-path multiplexer
  that supplies the DPLL reference, and its output rate is computed from the
  feedback/reference/output divider fields. The DPLL programming sequence is a
  validated calibration/trim procedure retained through the vendor library, so
  this producer is used unchanged by both the PDL and register-direct backends.

compatible: "infineon,cat1-dpll"

include: [clock-node.yaml]

properties:
  input:
    type: phandle
    required: true
    description: Clock-path multiplexer supplying the DPLL reference.

  instance:
    type: int
    required: true
    description: DPLL_LP instance index (0 or 1).

  clock-frequency:
    type: int
    required: true
    description: |
      Computed DPLL output frequency in Hz. Provided for devicetree reference
      and clock-state declarations; the actual output is determined by the
      divider fields below.

  feedback-div:
    type: int
    required: true
    description: Feedback divider (multiplier).

  reference-div:
    type: int
    required: true
    description: Reference (pre-) divider.

  output-div:
    type: int
    required: true
    description: Output (post-) divider.

  fraction-div:
    type: int
    default: 0
    description: Fractional feedback value in 1/2^24 steps.

  dco-mode-enable:
    type: boolean
    description: Enable DCO mode.

  "#clock-cells":
    const: 1

clock-cells:
  - dummy
```

## dts/bindings/clock-management/infineon/infineon,cat1-path-mux.yaml
```yaml
# SPDX-FileCopyrightText: Copyright (c) 2026 Infineon Technologies AG,
# or an affiliate of Infineon Technologies AG. All rights reserved.
#
# SPDX-License-Identifier: Apache-2.0

description: |
  Infineon CAT1 clock-path multiplexer for the clock-management framework.

  Models a path mux (FLL/DPLL reference selector) as an RFC "mux" clock. The
  single specifier cell is the zero-based index into input-sources, matching
  the generic clock-mux convention.

  The generic clock-mux binding cannot represent this hardware: the selection
  is applied through Cy_SysClk_ClkPathSetSource(path, source_enum), not a
  single writable register bitfield, and the devicetree input order does not
  encode the hardware source enum. The source-selects table below supplies
  that per-input mapping, which is why a vendor binding is required.

compatible: "infineon,cat1-path-mux"

include: [clock-node.yaml]

properties:
  instance:
    type: int
    required: true
    description: Clock-path index programmed by this mux.

  input-sources:
    type: phandles
    required: true
    description: Clock nodes that may be selected as the path source.

  source-selects:
    type: array
    required: true
    description: |
      Hardware source enum (IFX_CAT1_CLKPATH_IN_*) for each entry in
      input-sources, in the same order. Provides the index-to-enum mapping
      the generic clock-mux binding lacks.

  # Register-direct backend only (ignored by the PDL backend):
  reg-addr:
    type: int
    description: Absolute address of the clock-path select register.

  field-lsb:
    type: int
    description: Least-significant bit of the path-select bitfield.

  field-width:
    type: int
    description: Width in bits of the path-select bitfield.

  "#clock-cells":
    const: 1

clock-cells:
  - mux
```
