## dts/bindings/clock-management/infineon/infineon,cat1-peri-div.yaml
```yaml
# SPDX-FileCopyrightText: Copyright (c) 2026 Infineon Technologies AG,
# or an affiliate of Infineon Technologies AG. All rights reserved.
#
# SPDX-License-Identifier: Apache-2.0

description: |
  Infineon CAT1 peripheral clock divider (peri-div) for the clock-management
  framework.

  Models a peripheral divider channel as an RFC "standard" clock. The single
  specifier cell is the integer divide value (1-based, matching the existing
  infineon,peri-div clock-control binding). Fractional dividers use the
  optional div-frac-value property for the fractional part.

compatible: "infineon,cat1-peri-div"

include: [clock-node.yaml]

properties:
  input:
    type: phandle
    required: true
    description: Upstream clock (clk_hf) feeding this divider group.

  peri-group:
    type: uint8-array
    required: true
    description: Two bytes, [instance, group], identifying the divider block.

  div-type:
    type: int
    required: true
    description: |
      Divider type: 0 = 8-bit, 1 = 16-bit, 2 = 16.5-bit, 3 = 24.5-bit,
      matching the DIV_*_BIT tokens used by the existing PSC3 clock tree.

  channel:
    type: int
    required: true
    description: Divider channel within the group.

  clock-div:
    type: int
    default: 1
    description: |
      Default integer divide value (1-based). Used until a clock-state applies
      a new value through the specifier cell.

  div-frac-value:
    type: int
    default: 0
    description: Fractional part for 16.5-bit and 24.5-bit dividers.

  # Register-direct backend only (ignored by the PDL backend):
  reg-addr:
    type: int
    description: Absolute address of the divider control (DIV_x_CTL) register.

  cmd-reg-addr:
    type: int
    description: Absolute address of the group divider command (DIV_CMD) register.

  div-lsb:
    type: int
    description: Least-significant bit of the integer-divider field in the control register.

  div-width:
    type: int
    description: Width in bits of the integer-divider field.

  "#clock-cells":
    const: 1

clock-cells:
  - divider
```

## dts/bindings/i2c/zephyr,i2c-target-fault.yaml
```yaml
# SPDX-FileCopyrightText: Copyright The Zephyr Project Contributors
# SPDX-License-Identifier: Apache-2.0

description: |
  Programmable I2C target used to inject bus faults into a controller under
  test.

  The node describes a target answering a 7-bit address on the controller it
  is a child of. A second controller, wired to the same SDA and SCL, is the
  device under test. Tests arm the target through
  <zephyr/drivers/i2c/target/fault.h> to make it NACK an address, NACK a
  chosen data byte, refuse a read byte, or hold SCL.

  Example:

      &i2c1 {
              fault_target: fault-target@42 {
                      compatible = "zephyr,i2c-target-fault";
                      reg = <0x42>;
                      size = <32>;
              };
      };

compatible: "zephyr,i2c-target-fault"

include: [base.yaml, i2c-device.yaml]

properties:
  size:
    type: int
    default: 32
    description: |
      Size in bytes of the buffer the target presents. The first byte of a
      write selects the offset within the buffer, so the size must not exceed
      256.
```
